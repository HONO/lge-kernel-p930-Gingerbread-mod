## lge/com_device/Kconfig
```kconfig
#platform.team@lge.com	2011.01

menu "Audio"
source "lge/com_device/audio/Kconfig"
endmenu 

#ella.hwang@lge.com	2011.05.05
menu "Broadcast"
source "lge/com_device/broadcast/Kconfig"
endmenu 

menu "Camera"
source "lge/com_device/camera/Kconfig"
endmenu

menu "Display"
source "lge/com_device/display/Kconfig"
endmenu 

menu "Input"
source "lge/com_device/input/Kconfig"
endmenu

menu "Misc."
source "lge/com_device/misc/Kconfig"
endmenu

menu "Power"
source "lge/com_device/power/Kconfig"
endmenu

menu "Felica"
source "lge/com_device/felica/Kconfig"
endmenu

menu "MHL"
source "lge/com_device/mhl_v1/Kconfig"
endmenu
```

## lge/com_device/broadcast/Kconfig
```kconfig
#
# Broadcast Device Driver Support
#

menu "BROADCAST_DEVICE"

config LGE_BROADCAST_DCM
	bool "LGE broacast device"
	default n
	help
	  Select this if you want to use broadcast service
	  
endmenu
```

## lge/com_device/felica/Kconfig
```kconfig
#platform.team@lge.com	2011.01

comment "LGE Felica selection"

config LGE_FELICA
	bool "Felica driver"
	default y
	---help---
	LGE Felica related change	
```

## lge/lge_board/Kconfig
```kconfig
#platform.team@lge.com	2011.01

config MACH_LGE_I_BOARD
       bool "LGE_I_BOARD"
       depends on ARCH_MSM8X60
       default y
       ---help---
         LGE I-project. 

choice
	prompt "LGE board type"
	default MACH_LGE_I_BOARD_ATNT 

config MACH_LGE_I_BOARD_VZW
       bool "LGE_I_BOARD_VZW"
       depends on MACH_LGE_I_BOARD
       ---help---
         LGE I-project for VZW. 

config MACH_LGE_I_BOARD_ATNT
       bool "LGE_I_BOARD_ATNT"
       depends on MACH_LGE_I_BOARD
       ---help---
         LGE I-project for AT&T.

config MACH_LGE_I_BOARD_SKT
       bool "LGE_I_BOARD_SKT"
       depends on MACH_LGE_I_BOARD
       ---help---
         LGE I-project for SKT.         

config MACH_LGE_I_BOARD_LGU
       bool "LGE_I_BOARD_LGU"
       depends on MACH_LGE_I_BOARD
       ---help---
         LGE I-project for LGU.

config MACH_LGE_I_BOARD_DCM
       bool "LGE_I_BOARD_DCM"
       depends on MACH_LGE_I_BOARD
       ---help---
         LGE I-project for DoCoMo.         

config MACH_LGE_HDK_8x60
       bool "LGE_I_BOARD_HDK_8x60"
       depends on MACH_LGE_I_BOARD
       ---help---
         LGE I-project for HDK_8x60.

endchoice
 
```
